## conf/layer.conf
```bitbake
# We have a conf and classes directory, add to BBPATH
BBPATH .= ":${LAYERDIR}"

# We have recipes-* directories, add to BBFILES
BBFILES += "${LAYERDIR}/recipes-*/*/*.bb \
            ${LAYERDIR}/recipes-*/*/*.bbappend"

BBFILE_COLLECTIONS += "meta-rpi-connman-blacklist"
BBFILE_PATTERN_meta-rpi-connman-blacklist = "^${LAYERDIR}/"
BBFILE_PRIORITY_meta-rpi-connman-blacklist = "6"

LAYERDEPENDS_meta-rpi-connman-blacklist = "core"
LAYERSERIES_COMPAT_meta-rpi-connman-blacklist = "mickledore"
```
